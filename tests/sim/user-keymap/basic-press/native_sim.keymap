/* User keymap (config/cornix.keymap): tap Q (left hand) then P (right hand). */
#include "../../_common/user_keymap.dtsi"

&kscan {
    events = <
        ZMK_MOCK_PRESS(0,1,10)     /* position 1  = &kp Q */
        ZMK_MOCK_RELEASE(0,1,10)
        ZMK_MOCK_PRESS(0,8,10)     /* position 10 = &kp P */
        ZMK_MOCK_RELEASE(0,8,10)
    >;
};
