/*
 * User keymap (config/cornix.keymap): the mouse, which lives on the Fn3
 * layer (layer 4, held with position 45 = RC(3,11)).
 *
 *   45 + 8/19/20/21  (I/J/K/L)  -> &mmv MOVE_UP/LEFT/DOWN/RIGHT
 *   45 + 41          (thumb)    -> &mkp LCLK
 *   45 + 42          (thumb)    -> &mkp RCLK
 *   45 + 43          (thumb)    -> &mkp MCLK
 *   45 + 2  (W)      held       -> &mo 6, MouseSlow  -> &zip_xy_scaler 1 2
 *   45 + 3  (E)      held       -> &mo 7, MouseFast  -> &zip_xy_scaler 2 1
 *
 * 2026-09-19: the three clicks moved onto the three left thumb keys (they
 * were on 42/43, and before that on the two Space keys) and the speed keys
 * onto W/E (they were on D/F, and before that on U/O), so the whole left
 * hand drives the mouse while the right hand stays on I/J/K/L.  The two
 * scaling factors were softened from 1/3 and 3/1 to 1/2 and 2/1 at the same
 * time.
 *
 * MouseSlow/MouseFast are `&trans`-only layers; they exist only so that the
 * `&mmv_input_listener` overlay in the keymap can swap the input processors
 * while they are active.  The `&mmv` keys stay on Fn3 underneath, which is
 * fine: input_listener.c picks an override by zmk_keymap_layer_active()
 * alone, not by the layer the binding resolved on.
 *
 * The three movement chords below all hold position 8 for the same 200 ms,
 * so the `movement_set` values in the snapshot are directly comparable:
 * the MouseFast run must be about twice the plain run and the MouseSlow run
 * about half of it (the pre-defined `zip_xy_scaler` instances set
 * `track-remainders`, so the fractions are accumulated rather than truncated
 * away).  In the recorded snapshot the three runs sum to
 *
 *   plain      1+2+2+3+3+4+4+5+5+6            = 35 units over 10 reports
 *   MouseFast  2+4+4+6+6+8+8+10+10+12         = 70 units = exactly 2 x 35
 *   MouseSlow  1+1+2+1+2+2+3+2+3              = 17 units ~ 35 / 2
 *
 * (MouseSlow shows only nine lines because one of the ten reports scaled to
 * zero movement and events.patterns drops it.)  The `layer_id:` lines in the snapshot also show the resolution order that
 * makes this work: `layer_id: 7 position: 8, binding name: transparent`
 * followed by `layer_id: 4 position: 8, binding name: mouse_move`.
 *
 * Position 49 (RC(3,7)) is plain `&kp RIGHT` again - the old `&lt 6 RIGHT`
 * layer-tap and the keymap's `&lt` override are gone, so there is no
 * hold-tap in this keymap any more and no tapping term to wait out.
 */
#include "../../_common/user_keymap.dtsi"

&kscan {
    events = <
        /* 1. plain speed: hold Fn3, hold I */
        ZMK_MOCK_PRESS(3,11,50)     /* position 45 = &mo 4 -> Fn3 */
        ZMK_MOCK_PRESS(0,10,200)    /* position 8  = &mmv MOVE_UP */
        ZMK_MOCK_RELEASE(0,10,50)
        ZMK_MOCK_RELEASE(3,11,50)

        /* 2. Fn3 + 41 (the thumb rest key) = left click */
        ZMK_MOCK_PRESS(3,11,50)
        ZMK_MOCK_PRESS(3,3,50)      /* position 41 = &mkp LCLK */
        ZMK_MOCK_RELEASE(3,3,50)
        ZMK_MOCK_RELEASE(3,11,50)

        /* 3. Fn3 + 42 (the Num key) = right click */
        ZMK_MOCK_PRESS(3,11,50)
        ZMK_MOCK_PRESS(3,4,50)      /* position 42 = &mkp RCLK */
        ZMK_MOCK_RELEASE(3,4,50)
        ZMK_MOCK_RELEASE(3,11,50)

        /* 4. Fn3 + 43 (the left Space) = middle click */
        ZMK_MOCK_PRESS(3,11,50)
        ZMK_MOCK_PRESS(3,5,50)      /* position 43 = &mkp MCLK */
        ZMK_MOCK_RELEASE(3,5,50)
        ZMK_MOCK_RELEASE(3,11,50)

        /* 5. fast: hold Fn3 + E, then I */
        ZMK_MOCK_PRESS(3,11,20)
        ZMK_MOCK_PRESS(0,3,30)      /* position 3 = &mo 7 -> MouseFast */
        ZMK_MOCK_PRESS(0,10,200)    /* position 8 = &mmv MOVE_UP, scaled 2/1 */
        ZMK_MOCK_RELEASE(0,10,20)
        ZMK_MOCK_RELEASE(0,3,20)
        ZMK_MOCK_RELEASE(3,11,50)

        /* 6. slow: hold Fn3 + W, then I */
        ZMK_MOCK_PRESS(3,11,20)
        ZMK_MOCK_PRESS(0,2,30)      /* position 2 = &mo 6 -> MouseSlow */
        ZMK_MOCK_PRESS(0,10,200)    /* position 8 = &mmv MOVE_UP, scaled 1/2 */
        ZMK_MOCK_RELEASE(0,10,20)
        ZMK_MOCK_RELEASE(0,2,20)
        ZMK_MOCK_RELEASE(3,11,50)

        /* 7. a plain tap of position 49 -> RIGHT (0x4F) */
        ZMK_MOCK_PRESS(3,7,30)
        ZMK_MOCK_RELEASE(3,7,50)
    >;
};
