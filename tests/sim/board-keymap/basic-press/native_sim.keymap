/* Board default keymap: tap Q (left hand) then P (right hand). */
#include "../../_common/board_keymap.dtsi"

&kscan {
    events = <
        ZMK_MOCK_PRESS(0,1,10)     /* position 1  = Q */
        ZMK_MOCK_RELEASE(0,1,10)
        ZMK_MOCK_PRESS(0,8,10)     /* position 10 = P (right hand, RC(0,12-4)) */
        ZMK_MOCK_RELEASE(0,8,10)
    >;
};
