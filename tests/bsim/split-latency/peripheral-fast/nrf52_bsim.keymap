/*
 * Cornix split BLE peripheral (the right half) on Zephyr's BabbleSim board:
 * the "fast typing" scenario.
 *
 * After the same warm-up as peripheral/nrf52_bsim.keymap, the script replays
 * what a fast typist does on the right half, all on positions bound to &kp in
 * the Cornix keymap (no &mo / &trans, so every event also yields one HID
 * report on the simulated host):
 *
 *   1. a word burst of 36 presses with 2-key rollover: the next key goes
 *      down 15 ms before the previous one comes up, and successive presses
 *      are 35-60 ms apart (about 17-28 keys per second);
 *   2. a 4-key chord pressed within 3 ms (all four position changes fall
 *      inside one 7.5 ms connection interval), held 40 ms, released within
 *      3 ms;
 *   3. six single taps 35 ms apart.
 *
 * 46 presses / 92 position events in about 2.6 s of simulated time,
 * generated by the snippet in tests/bsim/README.md ("fast typing").
 * The peripheral's notify queue is 10 deep
 * (CONFIG_ZMK_SPLIT_BLE_PERIPHERAL_POSITION_QUEUE_SIZE) and the peripheral has
 * 3 ATT TX buffers (CONFIG_BT_ATT_TX_COUNT), so this is the load under which
 * "Position state message queue full" would show up if the link cannot keep
 * up.
 */

#include "../_common/cornix_bsim_keymap.dtsi"

&kscan {
    events = <
            ZMK_MOCK_PRESS(3,9,4000)     /* warm-up while the split link comes up */
            ZMK_MOCK_RELEASE(3,9,100)
            ZMK_MOCK_PRESS(0,12,40)         /* t ~ 8100 ms */
            ZMK_MOCK_PRESS(0,11,15)         /* t ~ 8140 ms */
            ZMK_MOCK_RELEASE(0,12,45)       /* t ~ 8155 ms */
            ZMK_MOCK_PRESS(0,10,15)         /* t ~ 8200 ms */
            ZMK_MOCK_RELEASE(0,11,25)       /* t ~ 8215 ms */
            ZMK_MOCK_PRESS(0,9,15)          /* t ~ 8240 ms */
            ZMK_MOCK_RELEASE(0,10,40)       /* t ~ 8255 ms */
            ZMK_MOCK_PRESS(0,8,15)          /* t ~ 8295 ms */
            ZMK_MOCK_RELEASE(0,9,30)        /* t ~ 8310 ms */
            ZMK_MOCK_PRESS(0,7,15)          /* t ~ 8340 ms */
            ZMK_MOCK_RELEASE(0,8,35)        /* t ~ 8355 ms */
            ZMK_MOCK_PRESS(1,12,15)         /* t ~ 8390 ms */
            ZMK_MOCK_RELEASE(0,7,20)        /* t ~ 8405 ms */
            ZMK_MOCK_PRESS(1,11,15)         /* t ~ 8425 ms */
            ZMK_MOCK_RELEASE(1,12,45)       /* t ~ 8440 ms */
            ZMK_MOCK_PRESS(1,10,15)         /* t ~ 8485 ms */
            ZMK_MOCK_RELEASE(1,11,35)       /* t ~ 8500 ms */
            ZMK_MOCK_PRESS(1,9,15)          /* t ~ 8535 ms */
            ZMK_MOCK_RELEASE(1,10,25)       /* t ~ 8550 ms */
            ZMK_MOCK_PRESS(1,8,15)          /* t ~ 8575 ms */
            ZMK_MOCK_RELEASE(1,9,40)        /* t ~ 8590 ms */
            ZMK_MOCK_PRESS(1,7,15)          /* t ~ 8630 ms */
            ZMK_MOCK_RELEASE(1,8,30)        /* t ~ 8645 ms */
            ZMK_MOCK_PRESS(2,12,15)         /* t ~ 8675 ms */
            ZMK_MOCK_RELEASE(1,7,20)        /* t ~ 8690 ms */
            ZMK_MOCK_PRESS(2,11,15)         /* t ~ 8710 ms */
            ZMK_MOCK_RELEASE(2,12,45)       /* t ~ 8725 ms */
            ZMK_MOCK_PRESS(2,10,15)         /* t ~ 8770 ms */
            ZMK_MOCK_RELEASE(2,11,25)       /* t ~ 8785 ms */
            ZMK_MOCK_PRESS(2,9,15)          /* t ~ 8810 ms */
            ZMK_MOCK_RELEASE(2,10,40)       /* t ~ 8825 ms */
            ZMK_MOCK_PRESS(3,12,15)         /* t ~ 8865 ms */
            ZMK_MOCK_RELEASE(2,9,30)        /* t ~ 8880 ms */
            ZMK_MOCK_PRESS(3,10,15)         /* t ~ 8910 ms */
            ZMK_MOCK_RELEASE(3,12,35)       /* t ~ 8925 ms */
            ZMK_MOCK_PRESS(0,12,15)         /* t ~ 8960 ms */
            ZMK_MOCK_RELEASE(3,10,20)       /* t ~ 8975 ms */
            ZMK_MOCK_PRESS(0,11,15)         /* t ~ 8995 ms */
            ZMK_MOCK_RELEASE(0,12,45)       /* t ~ 9010 ms */
            ZMK_MOCK_PRESS(0,10,15)         /* t ~ 9055 ms */
            ZMK_MOCK_RELEASE(0,11,35)       /* t ~ 9070 ms */
            ZMK_MOCK_PRESS(0,9,15)          /* t ~ 9105 ms */
            ZMK_MOCK_RELEASE(0,10,25)       /* t ~ 9120 ms */
            ZMK_MOCK_PRESS(0,8,15)          /* t ~ 9145 ms */
            ZMK_MOCK_RELEASE(0,9,40)        /* t ~ 9160 ms */
            ZMK_MOCK_PRESS(0,7,15)          /* t ~ 9200 ms */
            ZMK_MOCK_RELEASE(0,8,30)        /* t ~ 9215 ms */
            ZMK_MOCK_PRESS(1,12,15)         /* t ~ 9245 ms */
            ZMK_MOCK_RELEASE(0,7,20)        /* t ~ 9260 ms */
            ZMK_MOCK_PRESS(1,11,15)         /* t ~ 9280 ms */
            ZMK_MOCK_RELEASE(1,12,45)       /* t ~ 9295 ms */
            ZMK_MOCK_PRESS(1,10,15)         /* t ~ 9340 ms */
            ZMK_MOCK_RELEASE(1,11,25)       /* t ~ 9355 ms */
            ZMK_MOCK_PRESS(1,9,15)          /* t ~ 9380 ms */
            ZMK_MOCK_RELEASE(1,10,40)       /* t ~ 9395 ms */
            ZMK_MOCK_PRESS(1,8,15)          /* t ~ 9435 ms */
            ZMK_MOCK_RELEASE(1,9,30)        /* t ~ 9450 ms */
            ZMK_MOCK_PRESS(1,7,15)          /* t ~ 9480 ms */
            ZMK_MOCK_RELEASE(1,8,35)        /* t ~ 9495 ms */
            ZMK_MOCK_PRESS(2,12,15)         /* t ~ 9530 ms */
            ZMK_MOCK_RELEASE(1,7,20)        /* t ~ 9545 ms */
            ZMK_MOCK_PRESS(2,11,15)         /* t ~ 9565 ms */
            ZMK_MOCK_RELEASE(2,12,45)       /* t ~ 9580 ms */
            ZMK_MOCK_PRESS(2,10,15)         /* t ~ 9625 ms */
            ZMK_MOCK_RELEASE(2,11,35)       /* t ~ 9640 ms */
            ZMK_MOCK_PRESS(2,9,15)          /* t ~ 9675 ms */
            ZMK_MOCK_RELEASE(2,10,25)       /* t ~ 9690 ms */
            ZMK_MOCK_PRESS(3,12,15)         /* t ~ 9715 ms */
            ZMK_MOCK_RELEASE(2,9,40)        /* t ~ 9730 ms */
            ZMK_MOCK_PRESS(3,10,15)         /* t ~ 9770 ms */
            ZMK_MOCK_RELEASE(3,12,30)       /* t ~ 9785 ms */
            ZMK_MOCK_RELEASE(3,10,300)      /* t ~ 9815 ms */
            ZMK_MOCK_PRESS(0,12,1)          /* t ~ 10115 ms */
            ZMK_MOCK_PRESS(1,12,1)          /* t ~ 10116 ms */
            ZMK_MOCK_PRESS(2,12,1)          /* t ~ 10117 ms */
            ZMK_MOCK_PRESS(3,12,40)         /* t ~ 10118 ms */
            ZMK_MOCK_RELEASE(0,12,1)        /* t ~ 10158 ms */
            ZMK_MOCK_RELEASE(1,12,1)        /* t ~ 10159 ms */
            ZMK_MOCK_RELEASE(2,12,1)        /* t ~ 10160 ms */
            ZMK_MOCK_RELEASE(3,12,300)      /* t ~ 10161 ms */
            ZMK_MOCK_PRESS(0,12,15)         /* t ~ 10461 ms */
            ZMK_MOCK_RELEASE(0,12,20)       /* t ~ 10476 ms */
            ZMK_MOCK_PRESS(0,9,15)          /* t ~ 10496 ms */
            ZMK_MOCK_RELEASE(0,9,20)        /* t ~ 10511 ms */
            ZMK_MOCK_PRESS(1,12,15)         /* t ~ 10531 ms */
            ZMK_MOCK_RELEASE(1,12,20)       /* t ~ 10546 ms */
            ZMK_MOCK_PRESS(1,9,15)          /* t ~ 10566 ms */
            ZMK_MOCK_RELEASE(1,9,20)        /* t ~ 10581 ms */
            ZMK_MOCK_PRESS(2,12,15)         /* t ~ 10601 ms */
            ZMK_MOCK_RELEASE(2,12,20)       /* t ~ 10616 ms */
            ZMK_MOCK_PRESS(2,9,15)          /* t ~ 10636 ms */
            ZMK_MOCK_RELEASE(2,9,500)       /* t ~ 10651 ms */
    >;
};
